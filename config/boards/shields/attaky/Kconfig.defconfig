## config/boards/shields/attaky/Kconfig.defconfig
```kconfig
if SHIELD_ATTAKY_RIGHT

config ZMK_KEYBOARD_NAME
	default "Charybdis"

config ZMK_SPLIT_BLE_ROLE_CENTRAL
	default y

endif

if SHIELD_ATTAKY_LEFT || SHIELD_ATTAKY_RIGHT

config ZMK_SPLIT
	default y
	
endif
```

## config/boards/shields/attaky/Kconfig.shield
```kconfig
config SHIELD_ATTAKY_LEFT
    def_bool $(shields_list_contains,attaky_left)

config SHIELD_ATTAKY_RIGHT
    def_bool $(shields_list_contains,attaky_right)
```

## config/boards/shields/charybdis/Kconfig.defconfig
```kconfig
if SHIELD_CHARYBDIS
config ZMK_KEYBOARD_NAME
	default "Charybdis"

config ZMK_SPLIT_BLE_ROLE_CENTRAL
	default y

endif
```
